

double ekg[] = {
    0x7ff, 0x86a, 0x8d5, 0x93f, 0x9a9, 0xa11, 0xa78, 0xadd, 0xb40, 0xba1,
    0xbff, 0xc5a, 0xcb2, 0xd08, 0xd59, 0xda7, 0xdf1, 0xe36, 0xe77, 0xeb4,
    0xeec, 0xf1f, 0xf4d, 0xf77, 0xf9a, 0xfb9, 0xfd2, 0xfe5, 0xff3, 0xffc,
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    0x3ff, 0x45d, 0x4be, 0x521, 0x586, 0x5ed, 0x655, 0x6bf, 0x729, 0x794
  };
int counter = 0;
int incomingByte;
#define bits	10
	unsigned int i, total, ch1_position, MAX_LEVEL;
	unsigned int repeat, n;
	unsigned char plot_data1, plot_data2;
	signed long temp;
	

void setup() {
  Serial1.begin(115200);
  total = 120;
	repeat = 120 / total;	
        ch1_position = 250;
        MAX_LEVEL = 240;
}

void loop() {
  // see if there's incoming serial data:
  if (Serial1.available() > 0) {
    // read the oldest byte in the serial buffer:
    incomingByte = Serial1.read();
    // if it's a capital R, reset the counter
    if (incomingByte == 0x00) {
        
	
        Serial1.write(241);
	i=0;
	while( i<total )
	{
		/*** CHANNEL 1 ***/
		// refer to "adc.xmcd" (mathcad) for the computation
		temp = (ch1_position<<bits) / (long)MAX_LEVEL;
		temp = (long)0 + temp - (long)ekg[i++];
		temp = temp * (long)MAX_LEVEL;
		temp = (temp>>bits) + (ch1_position<<2) - (ch1_position);
		plot_data1 = temp>>2;
                
		//plot_data1 = clamp_value( temp );

		/*** CHANNEL 2 ***/
		temp = (ch2_position<<bits) / (long)MAX_LEVEL;
		temp = (long)OFFSET2 + temp - (long)raw_data[i++];
		temp = temp * (long)MAX_LEVEL * ch2_gain;
		temp = (temp>>bits) + (ch2_position<<2) - (ch2_position*ch2_gain);
		plot_data2 = temp>>2;
//		plot_data2 = clamp_value( temp );

//		n=repeat;
//		while(n--){
			Serial1.write(plot_data1);
                Serial1.write(plot_data2);
//		}

	}
        Serial1.write(242);
    }
  }
}
